## build/conf/bblayers.conf
```bitbake
# POKY_BBLAYERS_CONF_VERSION is increased each time build/conf/bblayers.conf
# changes incompatibly
POKY_BBLAYERS_CONF_VERSION = "2"

BBPATH = "${TOPDIR}"
BBFILES ?= ""

BBLAYERS ?= " \
  /media/jana/ea1e91f9-c640-467c-a7ac-a9c2e049af09/yocto/dunfell/recovery-usb-rpi3/layers/poky/meta \
  /media/jana/ea1e91f9-c640-467c-a7ac-a9c2e049af09/yocto/dunfell/recovery-usb-rpi3/layers/poky/meta-poky \
  /media/jana/ea1e91f9-c640-467c-a7ac-a9c2e049af09/yocto/dunfell/recovery-usb-rpi3/layers/poky/meta-yocto-bsp \
  /media/jana/ea1e91f9-c640-467c-a7ac-a9c2e049af09/yocto/dunfell/recovery-usb-rpi3/layers/meta-raspberrypi \
  /media/jana/ea1e91f9-c640-467c-a7ac-a9c2e049af09/yocto/dunfell/recovery-usb-rpi3/layers/meta-mender/meta-mender-core \
  /media/jana/ea1e91f9-c640-467c-a7ac-a9c2e049af09/yocto/dunfell/recovery-usb-rpi3/layers/meta-mender/meta-mender-raspberrypi \
  /media/jana/ea1e91f9-c640-467c-a7ac-a9c2e049af09/yocto/dunfell/recovery-usb-rpi3/layers/meta-openembedded/meta-oe \
  /media/jana/ea1e91f9-c640-467c-a7ac-a9c2e049af09/yocto/dunfell/recovery-usb-rpi3/layers/meta-recovery \
  "
```

## build/conf/local.conf
```bitbake
MACHINE ??= "raspberrypi3"
DL_DIR ?= "${TOPDIR}/downloads"
SSTATE_DIR ?= "${TOPDIR}/sstate-cache"
TMPDIR = "${TOPDIR}/tmp"

DISTRO ?= "poky"
PACKAGE_CLASSES ?= "package_ipk"
EXTRA_IMAGE_FEATURES ?= "debug-tweaks"
USER_CLASSES ?= "buildstats image-mklibs image-prelink"
PATCHRESOLVE = "user"

BB_DISKMON_DIRS ??= "\
    STOPTASKS,${TMPDIR},1G,100K \
    STOPTASKS,${DL_DIR},1G,100K \
    STOPTASKS,${SSTATE_DIR},1G,100K \
    STOPTASKS,/tmp,100M,100K \
    ABORT,${TMPDIR},100M,1K \
    ABORT,${DL_DIR},100M,1K \
    ABORT,${SSTATE_DIR},100M,1K \
    ABORT,/tmp,10M,1K"

BB_NUMBER_THREADS ?= "${@oe.utils.cpu_count()}"
PARALLEL_MAKE ?= "-j ${@oe.utils.cpu_count()}"

# This really saves a lot of disk space!
INHERIT += "rm_work"

RPI_USE_U_BOOT = "1"
IMAGE_FSTYPES_remove += " rpi-sdimg"

INHERIT += "mender-full"

# Select device tree .dtb file so that u-boot doesn't get confused
KERNEL_DEVICETREE = "bcm2710-rpi-3-b.dtb"

#ENABLE_UART = "1"
MENDER_ARTIFACT_NAME = "${BUILD_TAG}"

MENDER_BOOT_PART_SIZE_MB = "40"
MENDER_STORAGE_TOTAL_SIZE_MB = "14336"
MENDER_DATA_PART_SIZE_MB = "10240"

DISTRO_FEATURES_append = " systemd"
VIRTUAL-RUNTIME_init_manager = "systemd"
DISTRO_FEATURES_BACKFILL_CONSIDERED = "sysvinit"
VIRTUAL-RUNTIME_initscripts = ""

MENDER_FEATURES_ENABLE_append = " mender-uboot \
                                  mender-image \
                                  mender-image-sd \
                                  mender-client-install \
                                "
MENDER_FEATURES_DISABLE_append = " mender-grub \
                                   mender-image-uefi \
                                 "

# Appended fragment from meta-mender-community/meta-mender-raspberrypi/templates
IMAGE_INSTALL_append = " kernel-image \
                         kernel-devicetree \
                         hello-world \
                         recovery-usb \
                         udev-extraconf \
                       "


BUILD_TAG = "recovery-rpi3-2909-dunfell-r5"

CONF_VERSION = "1"
```
